## conf/external/Config.in
```kconfig
source "$BR2_EXTERNAL_SEL4_AMP_PATH/package/sel4_tool/Config.in"
source "$BR2_EXTERNAL_SEL4_AMP_PATH/package/opensc/Config.in"
```

## conf/external/package/opensc/Config.in
```kconfig
config BR2_PACKAGE_OPENSC
	bool "opensc"
	select BR2_PACKAGE_LIBOPENSSL
	select BR2_PACKAGE_PCSC_LITE
	help
		OpenSC provides a set of libraries and utilities to work with smart cards.

		https://github.com/OpenSC/OpenSC.git
```

## conf/external/package/soc_example/Config.in
```kconfig
config BR2_PACKAGE_SOC_EXAMPLE
    bool "Soc Example"
    help
        Polarfire system controller example
```
